## config/boards/shields/frustum/Kconfig.defconfig
```kconfig
if SHIELD_FRUSTUM_LEFT

config ZMK_KEYBOARD_NAME
    default "Frustum"

config ZMK_SPLIT_ROLE_CENTRAL
    default y

endif

if SHIELD_FRUSTUM_LEFT || SHIELD_FRUSTUM_RIGHT

config ZMK_SPLIT
    default y

endif

if ZMK_DISPLAY

config NICE_VIEW
    default y

endif
```

## config/boards/shields/frustum/Kconfig.shield
```kconfig
config SHIELD_FRUSTUM_LEFT
    def_bool $(shields_list_contains,frustum_left)

config SHIELD_FRUSTUM_RIGHT
    def_bool $(shields_list_contains,frustum_right)

config SHIELD_NICE_VIEW_GEM
    def_bool $(shields_list_contains,nice_view_gem)
```
